## drivers/jesd204/Kconfig
```kconfig
#
# JESD204 subsystem configuration
#

menuconfig JESD204
	tristate "JESD204 High-Speed Serial Interface Support"
	help
	  The JESD204 is a "Serial Interface for data converters"
	  which describes a serialized interface between data converters
	  and logic devices. It contains normative information to enable
	  chip designers to implement devices that communicate with other
	  devices covered by this specification.

	  The JESD204 subsystem provides a unified framework for
	  supporting initialization and operation of JESD204 transceivers,
	  which aims at reducing complexity when managing these types of
	  devices.

if JESD204

config AXI_JESD204B
	tristate "Generic AXI JESD204B configuration driver"
	depends on COMMON_CLK
	select XILINX_TRANSCEIVER

config JESD204_DEVICE
	tristate "Generic JESD204 configuration driver"
	depends on COMMON_CLK
	help
	  This is a generic driver that uses OF graph to aggregate
	  multiple other drivers in order to setup & configure JESD204
	  links. Various elements of a such a link are common to most
	  devices, and they're complex as they require tight
	  inter-operation of other elements.

	  This driver handles configuration for both RX & TX links,
	  as most logic is pushed to the JESD204 subsystem logic.

source "drivers/jesd204/linklayer/Kconfig"
source "drivers/jesd204/transceiver/Kconfig"

endif # JESD204
```
